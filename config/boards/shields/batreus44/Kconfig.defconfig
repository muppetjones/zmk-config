## config/boards/shields/batreus44/Kconfig.defconfig
```kconfig
# Copyright (c) 2022 The ZMK Contributors
# SPDX-License-Identifier: MIT


if SHIELD_BATREUS44

config ZMK_KEYBOARD_NAME
	default "Batreus44"


endif
```

## config/boards/shields/batreus44/Kconfig.shield
```kconfig
# Copyright (c) 2022 The ZMK Contributors
# SPDX-License-Identifier: MIT

config SHIELD_BATREUS44
	def_bool $(shields_list_contains,batreus44)
```

## config/boards/shields/hypergolic/Kconfig.shield
```kconfig
# Copyright (c) 2020 Pete Johanson
# SPDX-License-Identifier: MIT

config SHIELD_HYPERGOLIC_LEFT
	def_bool $(shields_list_contains,hypergolic_left)

config SHIELD_HYPERGOLIC_RIGHT
	def_bool $(shields_list_contains,hypergolic_right)
```

## config/boards/shields/sweep_v2/Kconfig.shield
```kconfig
# Copyright (c) 2020 Pete Johanson
# SPDX-License-Identifier: MIT

config SHIELD_SWEEP_V2_LEFT
	def_bool $(shields_list_contains,sweep_v2_left)

config SHIELD_SWEEP_V2_RIGHT
	def_bool $(shields_list_contains,sweep_v2_right)
```
