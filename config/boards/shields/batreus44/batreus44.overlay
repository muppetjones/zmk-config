/*
 * Copyright (c) 2022 The ZMK Contributors
 *
 * SPDX-License-Identifier: MIT
 */

#include <dt-bindings/zmk/matrix_transform.h>

#define L5 0
#define L4 1
#define L3 2
#define L2 3
#define L1 4
#define L0 5
#define R0 6
#define R1 7
#define R2 8
#define R3 9
#define R4 10
#define R5 11

#define S0 0
#define S1 1
#define S2 2
#define S3 3

/ {
    chosen {
        zmk,kscan = &kscan0;
        zmk,matrix_transform = &default_transform;
    };

    kscan0: kscan_0 {
        compatible = "zmk,kscan-gpio-matrix";
        label = "KSCAN";
        diode-direction = "col2row";

    //   L5  L4  L3  L2  L1  L0     R0  R1  R2  R3  R4  R5
    // ╭────────────────────╮         ╭────────────────────╮
    // │  0   1   2   3   4 │         │  5   6   7   8   9 │ S3
    // │ 10  11  12  13  14 ╰───╮ ╭───╯ 15  16  17  18  19 │ S2
    // │ 20  21  22  23  24  25 │ │ 26  27  28  29  30  31 │ S1
    // | 32  33  34  35  36  37 | | 38  39  40  41  42  43 | S0
    // ╰────────────────────────╯ ╰────────────────────────╯
        col-gpios
            = <&pro_micro 2 GPIO_ACTIVE_HIGH> // 0 L5
            , <&pro_micro 3 GPIO_ACTIVE_HIGH> // 1 L4
            , <&pro_micro 4 GPIO_ACTIVE_HIGH> // 2 L3
            , <&pro_micro 5 GPIO_ACTIVE_HIGH> // 3 L2
            , <&pro_micro 6 GPIO_ACTIVE_HIGH> // 4 L1
            , <&pro_micro 7 GPIO_ACTIVE_HIGH> // 5 L0
            , <&pro_micro 14 GPIO_ACTIVE_HIGH> // 6 R0
            , <&pro_micro 15 GPIO_ACTIVE_HIGH> // 7 R1
            , <&pro_micro 18 GPIO_ACTIVE_HIGH> // 8 R2
            , <&pro_micro 19 GPIO_ACTIVE_HIGH> // 9 R3
            , <&pro_micro 20 GPIO_ACTIVE_HIGH> // 10 R4
            , <&pro_micro 21 GPIO_ACTIVE_HIGH> // 11 R5
            ;

        // ordered top to bottom to
        row-gpios
            = <&pro_micro 9 (GPIO_ACTIVE_HIGH | GPIO_PULL_DOWN)> // S0
            , <&pro_micro 8 (GPIO_ACTIVE_HIGH | GPIO_PULL_DOWN)> // S1
            , <&pro_micro 10 (GPIO_ACTIVE_HIGH | GPIO_PULL_DOWN)> // S2
            , <&pro_micro 16 (GPIO_ACTIVE_HIGH | GPIO_PULL_DOWN)> // S3
            ;
    };

    default_transform: keymap_transform_0 {
        compatible = "zmk,matrix-transform";
        columns = <12>;
        rows = <4>;
        map = <
// 2:L5   3:L4      4:L3      5:L2      6:L1      ╭────── 7:L0 ─────╮ 15:R1     18:R2     19:R3     20:R4     21:R5
RC(S3,L5) RC(S3,L4) RC(S3,L3) RC(S3,L2) RC(S3,L1)                     RC(S3,R1) RC(S3,R2) RC(S3,R3) RC(S3,R4) RC(S3,R5) // 10
RC(S2,L5) RC(S2,L4) RC(S2,L3) RC(S2,L2) RC(S2,L1)                     RC(S2,R1) RC(S2,R2) RC(S2,R3) RC(S2,R4) RC(S2,R5) // 10
RC(S1,L5) RC(S1,L4) RC(S1,L3) RC(S1,L2) RC(S1,L1) RC(S1,L0) RC(S1,R0) RC(S1,R1) RC(S1,R2) RC(S1,R3) RC(S1,R4) RC(S1,R5) // 8
RC(S0,L5) RC(S0,L4) RC(S0,L3) RC(S0,L2) RC(S0,L1) RC(S0,L0) RC(S0,R0) RC(S0,R1) RC(S0,R2) RC(S0,R3) RC(S0,R4) RC(S0,R5) // 9
        >;
    };
};

